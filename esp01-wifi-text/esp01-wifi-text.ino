#include<FastLED.h>
#include <Arduino.h>
#include <ESP8266WiFi.h>
#include <WiFiClient.h>
#include <ESP8266WebServer.h>
#include <ESP8266mDNS.h>
#include <ArduinoJson.h>

FASTLED_USING_NAMESPACE

#define uS_TO_S_FACTOR 1000000
#define TIME_TO_SLEEP 30 * 60

#define DATA_PIN    2
#define LED_TYPE    WS2811
#define COLOR_ORDER GRB
#define NUM_LEDS    64
#define BRIGHTNESS  50
#define WIDTH       8
#define HEIGHT      8
#define MAX_ATTEMPTS 8
#define FRAMES_PER_SECOND  120

const char *SSID = "wifi-sa-bahay-V2.4";
const char *PWD = "wifi-sa-bahay-V2.4-password";

boolean stopScroll = false;

uint32_t cycle;

String message;

ESP8266WebServer server(80);

StaticJsonDocument<250> jsonDocument;
char buffer[250];

CRGB leds[NUM_LEDS];
uint8_t bufferArray[WIDTH * HEIGHT];

const uint8_t characterMatrices[256][64] = {
{0,0,0,0,0,0,0,0,0,0,0,0,0,0,0,0,0,0,0,0,0,0,0,0,0,0,0,0,0,0,0,0,0,0,0,0,0,0,0,0,0,0,0,0,0,0,0,0,0,0,0,0,0,0,0,0,0,0,0,0,0,0,0,0},
{0,0,0,0,0,0,0,0,0,0,0,0,0,0,0,0,0,0,0,0,0,0,0,0,0,0,0,0,0,0,0,0,0,0,0,0,0,0,0,0,0,0,0,0,0,0,0,0,0,0,0,0,0,0,0,0,0,0,0,0,0,0,0,0},
{0,0,0,0,0,0,0,0,0,0,0,0,0,0,0,0,0,0,0,0,0,0,0,0,0,0,0,0,0,0,0,0,0,0,0,0,0,0,0,0,0,0,0,0,0,0,0,0,0,0,0,0,0,0,0,0,0,0,0,0,0,0,0,0},
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{0,0,0,0,0,0,0,0,0,0,0,0,0,0,0,0,0,0,0,0,0,0,0,0,0,0,0,0,0,0,0,0,0,0,0,0,0,0,0,0,0,0,0,0,0,0,0,0,0,0,0,0,0,0,0,0,0,0,0,0,0,0,0,0}
};

void setup_routing(){
  server.on("/post", HTTP_POST, handle_post);
  server.on("/stopCommand", HTTP_POST, handle_stop_scroll);

  server.begin();
}

void handle_post(){
  message = server.arg("message");
  int foregroundColor = server.arg("foreground-color").toInt();
  int backgroundColor = server.arg("background-color").toInt();
  int cycles = server.arg("cycles").toInt();
  int brightness = server.arg("brightness").toInt();
  int del = server.arg("delay").toInt();
  Serial.print("Message: ");
  Serial.println(message);
  Serial.print("Foreground: ");
  Serial.println(foregroundColor);
  Serial.print("Background: ");
  Serial.println(backgroundColor);
  Serial.print("Cycles: ");
  Serial.println(cycles);
  Serial.print("Brightness: ");
  Serial.println(brightness);
  Serial.print("Delay: ");
  Serial.println(del);
//  server.sendHeader("Access-Control-Allow-Origin", "http://127.0.0.1:5500");
  server.send(200, "application/json", "{OK}");
  scroll(message, cycles, brightness, del, foregroundColor, backgroundColor);
}

void handle_stop_scroll(){
  String command = server.arg("command");
  if(!stopScroll && command == "stop") stopScroll = true;
  server.send(200, "application/json", "{OK}");
}

void setup() {
  delay(3000); // 3 second delay for recovery
  FastLED.addLeds<LED_TYPE, DATA_PIN, COLOR_ORDER>(leds, NUM_LEDS).setCorrection(TypicalLEDStrip);
  FastLED.setBrightness(BRIGHTNESS);  
  // put your setup code here, to run once:
  Serial.begin(115200);

  Serial.print("Connecting to WiFi");
  WiFi.begin(SSID, PWD);
  uint8_t num_attempts = 0;
  while(WiFi.status() != WL_CONNECTED){
    Serial.print(".");
    delay(500);
    if(num_attempts >= MAX_ATTEMPTS){
//      esp_sleep_enable_timer_wakeup(1 * uS_TO_S_FACTOR);
//      esp_deep_sleep_start();
    }
    leds[num_attempts + 4 * WIDTH] = CRGB::Green;
    FastLED.show();
    num_attempts++;
  }
  fill_solid(leds, 64, CRGB::Red);
  FastLED.show();
  delay(1000);
  

  Serial.print("Connected! IP Address: ");
  Serial.println(WiFi.localIP());
  setup_routing();
  // put your setup code here, to run once:
  fill_solid(leds, 64, 0x000000);
  FastLED.show();
  cycle = 1;
}

// List of patterns to cycle through.  Each is defined as a separate function below.
typedef void (*SimplePatternList[])();
SimplePatternList gPatterns = { rainbow, rainbowWithGlitter, confetti, sinelon, juggle, bpm };

uint8_t gCurrentPatternNumber = 0; // Index number of which pattern is current
uint8_t gHue = 0; // rotating "base color" used by many of the patterns

void loop() {
  // Call the current pattern function once, updating the 'leds' array
  gPatterns[gCurrentPatternNumber]();

  // send the 'leds' array out to the actual LED strip
  FastLED.show();  
  // insert a delay to keep the framerate modest
  delay(1000/FRAMES_PER_SECOND); 
  if(cycle % 100 == 0){
    server.handleClient();
    cycle = 1;
  }
  // do some periodic updates
  EVERY_N_MILLISECONDS( 20 ) { gHue++; } // slowly cycle the "base color" through the rainbow
  EVERY_N_SECONDS( 10 ) { nextPattern(); } // change patterns periodically
  
  cycle++;
}

void appendEnd(char c, uint8_t col_to_append){
  for(uint8_t col = 0; col < 7; col++){
    for(uint8_t row = 0; row < 8; row++){
      bufferArray[col + row * 8] = bufferArray[(col + 1) + row * 8];
    }
  }
  for(uint8_t row = 0; row < 8; row++){
    bufferArray[7 + row * 8] = characterMatrices[(uint8_t) c][col_to_append + row * 8];
  }
}

void printBuffer(uint32_t foregroundColor, uint32_t backgroundColor){
  for(int i = 0; i < NUM_LEDS; i++){
    leds[i] = bufferArray[i] == 1?foregroundColor:backgroundColor;
  }
  FastLED.show();
}

void scroll(String s, int cycles, uint8_t brightness, uint16_t del, uint32_t foreground, uint32_t background){
  FastLED.setBrightness(brightness);
  for(int cycle = 0; cycle < cycles; cycle++){
    server.handleClient();
    for(char c : s){
      for(uint8_t col = 0; col < WIDTH; col++){
        if(stopScroll){
          stopScroll = false;
          fill_solid(leds, 64, 0);
          return;
        }
        appendEnd(c, col);
        printBuffer(foreground, background);
        delay(del);
      }
    }
  }
  // turn all the leds off  
  fill_solid(leds, 64, 0x000000);
  FastLED.show();
}

#define ARRAY_SIZE(A) (sizeof(A) / sizeof((A)[0]))

void nextPattern()
{
  // add one to the current pattern number, and wrap around at the end
  gCurrentPatternNumber = (gCurrentPatternNumber + 1) % ARRAY_SIZE( gPatterns);
}

void rainbow() 
{
  // FastLED's built-in rainbow generator
  fill_rainbow( leds, NUM_LEDS, gHue, 7);
}

void rainbowWithGlitter() 
{
  // built-in FastLED rainbow, plus some random sparkly glitter
  rainbow();
  addGlitter(80);
}

void addGlitter( fract8 chanceOfGlitter) 
{
  if( random8() < chanceOfGlitter) {
    leds[ random16(NUM_LEDS) ] += CRGB::White;
  }
}

void confetti() 
{
  // random colored speckles that blink in and fade smoothly
  fadeToBlackBy( leds, NUM_LEDS, 10);
  int pos = random16(NUM_LEDS);
  leds[pos] += CHSV( gHue + random8(64), 200, 255);
}

void sinelon()
{
  // a colored dot sweeping back and forth, with fading trails
  fadeToBlackBy( leds, NUM_LEDS, 20);
  int pos = beatsin16( 13, 0, NUM_LEDS-1 );
  leds[pos] += CHSV( gHue, 255, 192);
}

void bpm()
{
  // colored stripes pulsing at a defined Beats-Per-Minute (BPM)
  uint8_t BeatsPerMinute = 62;
  CRGBPalette16 palette = PartyColors_p;
  uint8_t beat = beatsin8( BeatsPerMinute, 64, 255);
  for( int i = 0; i < NUM_LEDS; i++) { //9948
    leds[i] = ColorFromPalette(palette, gHue+(i*2), beat-gHue+(i*10));
  }
}

void juggle() {
  // eight colored dots, weaving in and out of sync with each other
  fadeToBlackBy( leds, NUM_LEDS, 20);
  uint8_t dothue = 0;
  for( int i = 0; i < 8; i++) {
    leds[beatsin16( i+7, 0, NUM_LEDS-1 )] |= CHSV(dothue, 200, 255);
    dothue += 32;
  }
}
